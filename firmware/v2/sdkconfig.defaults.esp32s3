## firmware/v2/sdkconfig.defaults.esp32s3
```kconfig
# PSRAM (SPIRAM) for ESP32-S3 - ensure heap uses external RAM
CONFIG_SPIRAM_SUPPORT=y
CONFIG_SPIRAM_USE_MALLOC=y
CONFIG_SPIRAM_CACHE_WORKAROUND=y
```

## tab5-encoder/sdkconfig.defaults
```kconfig
# Tab5 Encoder — ESP32-P4 Memory Configuration
# Created 2026-04-03 as part of memory audit optimisation

# PSRAM (32 MB HEX mode on M5Stack Tab5)
CONFIG_SPIRAM=y
CONFIG_SPIRAM_MODE_HEX=y
CONFIG_SPIRAM_SPEED_200M=y
CONFIG_SPIRAM_USE_MALLOC=y
CONFIG_SPIRAM_MALLOC_ALWAYSINTERNAL=4096
CONFIG_SPIRAM_MALLOC_RESERVE_INTERNAL=32768
CONFIG_SPIRAM_ALLOW_BSS_SEG_EXTERNAL_MEMORY=y

# Compiler optimisation — size produces better cache efficiency on P4
CONFIG_COMPILER_OPTIMIZATION_SIZE=y
```
